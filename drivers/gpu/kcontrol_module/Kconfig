## drivers/gpu/kcontrol_module/Kconfig
```kconfig
config KCONTROL_GPU_MODULE_MSM
        tristate "Kcontrol GPU Module for MSM"
        default n
        depends on ARCH_MSM && MODULES
	help
	  Enable Advanced GPU Options in KControl for MSM Devices
```
